## main/Kconfig.projbuild
```kconfig
menu "MY PROJECT configuration"

##
## LED On-devboard
choice MY_LED_ON_DEVBOARD_GPIO_NUM
    prompt "On-devboard LED GPIO#"
    default MY_LED_ON_DEVBOARD_GPIO_NUM_HUZZAH32_13
    help
        The on-devboard LED GPIO# to be used.
config MY_LED_ON_DEVBOARD_GPIO_NUM_HUZZAH32_13
    bool "HUZZAH32 GPIO#13"
config MY_LED_ON_DEVBOARD_GPIO_NUM_LOLIN32LITE_22
    bool "LOLIN32LITE GPIO#22"
config MY_LED_ON_DEVBOARD_GPIO_NUM_LOLIND32_5
    bool "LOLIND32 GPIO#5"
config MY_LED_ON_DEVBOARD_GPIO_NUM_OTHER
    bool "Other GPIO#"
endchoice
config MY_LED_ON_DEVBOARD_GPIO_NUM_OTHER_VAL
    int "Other on-devboard LED GPIO#" if MY_LED_ON_DEVBOARD_GPIO_NUM_OTHER
    default 99
config MY_LED_ON_DEVBOARD_GPIO_NUM
    int
    default 13 if MY_LED_ON_DEVBOARD_GPIO_NUM_HUZZAH32_13
    default 22 if MY_LED_ON_DEVBOARD_GPIO_NUM_LOLIN32LITE_22
    default  5 if MY_LED_ON_DEVBOARD_GPIO_NUM_LOLIND32_5
    default MY_LED_ON_DEVBOARD_GPIO_NUM_OTHER_VAL if MY_LED_ON_DEVBOARD_GPIO_NUM_OTHER

choice MY_LED_ON_DEVBOARD_WIRING_TYPE
    prompt "LED on-board wiring type"
    default MY_LED_ON_DEVBOARD_WIRING_TYPE_LED_LOW_SIDE
    help
        The LED on-board wiring type to be used.
config MY_LED_ON_DEVBOARD_WIRING_TYPE_LED_LOW_SIDE
    bool "LED_LOW_SIDE (HUZZAH32)"
config MY_LED_ON_DEVBOARD_WIRING_TYPE_LED_HIGH_SIDE
    bool "LED_HIGH_SIDE (LOLIN32LITE, LOLIND32)"
endchoice
config MY_LED_ON_DEVBOARD_WIRING_TYPE
    int
    default 1 if MY_LED_ON_DEVBOARD_WIRING_TYPE_LED_LOW_SIDE
    default 2 if MY_LED_ON_DEVBOARD_WIRING_TYPE_LED_HIGH_SIDE

##
## WIFI
config MY_WIFI_SSID
    string "MY_WIFI_SSID"
    default "AREA51"

config MY_WIFI_PASSWORD
    string "MY_WIFI_PASSWORD"
    default "jupijupi"    

##
## DEVICE
config MY_DEVICE_ID
    string "MY_DEVICE_ID [default devpir01]"
    default "devpir01"

config MY_DEVICE_SNTP_RESYNC_AFTER_X_BOOTS
    int "MY_DEVICE_SNTP_RESYNC_AFTER_X_BOOTS The datetime during deep sleep deviates too much [default 250]"
    default 250

##
## SENSOR
config MY_SENSOR_GPIO_INPUT_PIN
    int "MY_SENSOR_GPIO_INPUT_PIN pir_sensor/button [default 27]"
    default 27
    
config MY_SENSOR_BLOCKING_TIME_AFTER_TRIGGER_SECONDS
    int "MY_SENSOR_BLOCKING_TIME_AFTER_TRIGGER_SECONDS [default 30]"
    default 30

##
## UDP SERVER    
choice MY_DO_UPLOAD_TO_UDP_SERVER
    prompt "Upload to UDP Server? [default Yes]"
    default MY_UPLOAD_TO_UDP_SERVER_YES
config MY_DO_UPLOAD_TO_UDP_SERVER_YES
    bool "Yes"
config MY_DO_UPLOAD_TO_UDP_SERVER_NO
    bool "No"
endchoice
config MY_DO_UPLOAD_TO_UDP_SERVER
    int
    default 1 if MY_DO_UPLOAD_TO_UDP_SERVER_YES
    default 0 if MY_DO_UPLOAD_TO_UDP_SERVER_NO

config MY_UDP_SERVER_HOSTNAME
    string "MY_UDP_SERVER_HOSTNAME Examples: 192.168.0.94 192.168.0.95 www.google.com"
    default "192.168.0.94"

config MY_UDP_SERVER_PORT
    int "MY_UDP_SERVER_PORT Examples: 3001 for .94, 12703 for .95"
    default 3001

endmenu
```
